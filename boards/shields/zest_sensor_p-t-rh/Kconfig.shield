## boards/shields/zest_sensor_p-t-rh/Kconfig.shield
```kconfig
# Copyright (c) 2024 CATIE
# SPDX-License-Identifier: Apache-2.0

config SHIELD_ZEST_SENSOR_P_T_RH
	def_bool $(shields_list_contains,zest_sensor_p-t-rh)
	select I2C

config SHIELD_ZEST_SENSOR_P_T_RH_ALT
	def_bool $(shields_list_contains,zest_sensor_p-t-rh_alt)
	select I2C
```

## west.yml
```yaml
# Copyright (c) 2024 CATIE
# SPDX-License-Identifier: Apache-2.0

manifest:
  remotes:
    - name: catie-6tron
      url-base: https://github.com/catie-aq

  projects:
    - name: ams-as621x
      remote: catie-6tron
      repo-path: zephyr_ams-as621x
      revision: master
```
