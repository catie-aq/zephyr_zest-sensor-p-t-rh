/*
 * Copyright (c) 2024 CATIE
 *
 * SPDX-License-Identifier: Apache-2.0
 */

#include <zephyr/dt-bindings/gpio/sixtron-header.h>

#define PERIPHERAL_ZEST_SENSOR_P_T_RH_ALT(port) \
	i2c_zest_sensor_p_t_rh_##port: &sixtron_connector_##port##_i2c {};

#define DRIVERS_ZEST_SENSOR_P_T_RH_ALT(port) \
	&i2c_zest_sensor_p_t_rh_##port { \
		status = "okay"; \
		o2smpb_02e_zest_sensor_p_t_rh_##port: o2smpb-02e##port@70 { \
			compatible = "omron,2smpb-02e"; \
			reg = <0x70>; \
		}; \
		ams621x_zest_sensor_p_t_rh_##port: as621x##port@48 { \
			compatible = "ams,as621x"; \
			reg = <0x48>; \
		}; \
		htu21d_zest_sensor_p_t_rh_##port: htu21d##port@40 { \
			compatible = "te-connectivity,htu21d"; \
			reg = <0x40>; \
		}; \
	};

#define ONE_WIRE_ZEST_SENSOR_P_T_RH_ALT(port, w1_pin) \
	/ { \
		w1_zest_sensor_p_t_rh_##port: w1##port { \
			compatible = "zephyr,w1-gpio"; \
			gpios = <&sixtron_connector_##port w1_pin (GPIO_ACTIVE_HIGH | GPIO_OPEN_DRAIN | GPIO_PULL_UP)>; \
			ds18b20_zest_sensor_p_t_rh_##port: ds18b20##port { \
				compatible = "maxim,ds18b20"; \
				status = "disabled"; \
				family-code = <0x28>; \
				resolution = <12>; \
			}; \
		}; \
	};

#define ALIASES_ZEST_SENSOR_P_T_RH_ALT(port) \
	/ { \
		aliases { \
			o2smpb-02e = &o2smpb_02e_zest_sensor_p_t_rh_##port; \
			ams621x = &ams621x_zest_sensor_p_t_rh_##port; \
			htu21d = &htu21d_zest_sensor_p_t_rh_##port; \
			w1 = &w1_zest_sensor_p_t_rh_##port; \
		}; \
	};

#define ZEST_SENSOR_P_T_RH_ALT(port, w1) \
	PERIPHERAL_ZEST_SENSOR_P_T_RH_ALT(port) \
	DRIVERS_ZEST_SENSOR_P_T_RH_ALT(port) \
	ONE_WIRE_ZEST_SENSOR_P_T_RH_ALT(port, w1) \
	ALIASES_ZEST_SENSOR_P_T_RH_ALT(port)
